## uboot/board/freescale/dcp1000l/Kconfig
```kconfig
if TARGET_DCP_1000L

config SYS_BOARD
	default "dcp1000l"

config SYS_VENDOR
	default "freescale"

config SYS_SOC
	default "mx6"

config SYS_CONFIG_NAME
	default "dcp1000l"

endif
```

## uboot/board/freescale/mx6g2c/Kconfig
```kconfig
if TARGET_MX6G2C

config SYS_BOARD
	default "mx6g2c"

config SYS_VENDOR
	default "freescale"

config SYS_SOC
	default "mx6"

config SYS_CONFIG_NAME
	default "mx6g2c"

endif
```

## uboot/configs/a6g1c_sd_128m_defconfig
```kconfig
CONFIG_SYS_EXTRA_OPTIONS="IMX_CONFIG=board/freescale/mx6g2c/imximage.cfg,MX6UL,BOARD_A6G1C,BOARD_1C"
CONFIG_ARM=y
CONFIG_TARGET_MX6G2C=y
CONFIG_DM=y
CONFIG_DM_THERMAL=y
```

## uboot/configs/a6g1c_sd_256m_defconfig
```kconfig
CONFIG_SYS_EXTRA_OPTIONS="IMX_CONFIG=board/freescale/mx6g2c/imximage.cfg,MX6UL,BOARD_A6G1C,DDR_NAND_256M,BOARD_1C"
CONFIG_ARM=y
CONFIG_TARGET_MX6G2C=y
CONFIG_DM=y
CONFIG_DM_THERMAL=y
```

## uboot/configs/a6g2c_sd_256m_defconfig
```kconfig
CONFIG_SYS_EXTRA_OPTIONS="IMX_CONFIG=board/freescale/mx6g2c/imximage.cfg,MX6UL,BOARD_A6G2C,DDR_NAND_256M"
CONFIG_ARM=y
CONFIG_TARGET_MX6G2C=y
CONFIG_DM=y
CONFIG_DM_THERMAL=y
```

## uboot/configs/dcp_1000l_nand_128m_defconfig
```kconfig
CONFIG_SYS_EXTRA_OPTIONS="IMX_CONFIG=board/freescale/dcp1000l/imximage.cfg,MX6UL,BOARD_M6G2C,SYS_BOOT_NAND"
CONFIG_ARM=y
CONFIG_TARGET_DCP_1000L=y
CONFIG_DM=y
CONFIG_DM_THERMAL=y
```

## uboot/configs/dcp_1000l_nand_256m_defconfig
```kconfig
CONFIG_SYS_EXTRA_OPTIONS="IMX_CONFIG=board/freescale/dcp1000l/imximage.cfg,MX6UL,BOARD_M6G2C,SYS_BOOT_NAND,DDR_NAND_256M"
CONFIG_ARM=y
CONFIG_TARGET_DCP_1000L=y
CONFIG_DM=y
CONFIG_DM_THERMAL=y
```

## uboot/configs/mx6g1c_nand_128m_defconfig
```kconfig
CONFIG_SYS_EXTRA_OPTIONS="IMX_CONFIG=board/freescale/mx6g2c/imximage.cfg,MX6UL,SYS_BOOT_NAND,BOARD_M6G1C,BOARD_1C"
CONFIG_ARM=y
CONFIG_TARGET_MX6G2C=y
CONFIG_DM=y
CONFIG_DM_THERMAL=y
```
